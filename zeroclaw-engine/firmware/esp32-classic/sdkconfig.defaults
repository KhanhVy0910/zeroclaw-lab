## zeroclaw-engine/firmware/esp32-classic/sdkconfig.defaults
```kconfig
CONFIG_ESP_MAIN_TASK_STACK_SIZE=20000
CONFIG_ESPTOOLPY_FLASHSIZE_4MB=y
CONFIG_ESPTOOLPY_FLASHSIZE="4MB"
CONFIG_PARTITION_TABLE_CUSTOM=y
CONFIG_PARTITION_TABLE_CUSTOM_FILENAME="E:/gateway/zeroclaw-lab/zeroclaw-engine/firmware/esp32-classic/partitions.csv"
CONFIG_PARTITION_TABLE_OFFSET=0x8000
```
